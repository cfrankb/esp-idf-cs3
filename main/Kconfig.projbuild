## main/Kconfig.projbuild
```kconfig
menu "TFT Configuration"

	config GPIO_RANGE_MAX
		int
		default 33 if IDF_TARGET_ESP32
		default 46 if IDF_TARGET_ESP32S2
		default 19 if IDF_TARGET_ESP32C3
		default 48 if IDF_TARGET_ESP32S3

	choice DRIVER
		prompt "Display Driver"
		default ILI9341
		help
			Select Display Driver.
		config ILI9225
			bool "ILI9225"
			help
				Display Driver is ILI9225.
		config ILI9225G
			bool "ILI9225G"
			help
				Display Driver is ILI9225G.
		config ILI9340
			bool "ILI9340"
			help
				Display Driver is ILI9340.
		config ILI9341
			bool "ILI9341"
			help
				Display Driver is ILI9341.
		config ST7735
			bool "ST7735"
			help
				Display Driver is ST7735.
		config ST7789
			bool "ST7789"
			help
				Display Driver is ST7789.
		config ST7796
			bool "ST7796"
			help
				Display Driver is ST7796S.
	endchoice

	config WIDTH
		int "SCREEN WIDTH"
		range 0 999
		default 240
		help
			The width resolution of the screen.

	config HEIGHT
		int "SCREEN HEIGHT"
		range 0 999
		default 240
		help
			The height resolution of the screen.

	config OFFSETX
		int "GRAM X OFFSET"
		range 0 99
		default 0
		help
			When your TFT have offset(X), set it.

	config OFFSETY
		int "GRAM Y OFFSET"
		range 0 99
		default 0
		help
			When your TFT have offset(Y), set it.

	config MOSI_GPIO
		int "MOSI GPIO number"
		range 0 GPIO_RANGE_MAX
		default 23 if IDF_TARGET_ESP32
		default 35 if IDF_TARGET_ESP32S2
		default 35 if IDF_TARGET_ESP32S3
		default 0  if IDF_TARGET_ESP32C3
		help
			GPIO number (IOxx) to SPI MOSI.
			Some GPIOs are used for other purposes (flash connections, etc.) and cannot be used to MOSI.
			On the ESP32, GPIOs 35-39 are input-only so cannot be used as outputs.
			On the ESP32-S2, GPIO 46 is input-only so cannot be used as outputs.

	config SCLK_GPIO
		int "SCLK GPIO number"
		range 0 GPIO_RANGE_MAX
		default 18 if IDF_TARGET_ESP32
		default 36 if IDF_TARGET_ESP32S2
		default 36 if IDF_TARGET_ESP32S3
		default 1  if IDF_TARGET_ESP32C3
		help
			GPIO number (IOxx) to SPI SCLK.
			Some GPIOs are used for other purposes (flash connections, etc.) and cannot be used to SCLK.
			On the ESP32, GPIOs 35-39 are input-only so cannot be used as outputs.
			On the ESP32-S2, GPIO 46 is input-only so cannot be used as outputs.

	config CS_GPIO
		int "CS GPIO number"
		range -1 GPIO_RANGE_MAX
		default -1 if IDF_TARGET_ESP32
		default -1 if IDF_TARGET_ESP32S2
		default -1 if IDF_TARGET_ESP32S3
		default -1 if IDF_TARGET_ESP32C3
		help
			GPIO number (IOxx) to SPI CS.
			When it is -1, CS isn't performed.
			Some GPIOs are used for other purposes (flash connections, etc.) and cannot be used to CS.
			On the ESP32, GPIOs 35-39 are input-only so cannot be used as outputs.
			On the ESP32-S2, GPIO 46 is input-only so cannot be used as outputs.

	config DC_GPIO
		int "DC GPIO number"
		range 0 GPIO_RANGE_MAX
		default 27 if IDF_TARGET_ESP32
		default 37 if IDF_TARGET_ESP32S2
		default 40 if IDF_TARGET_ESP32S3
		default 2  if IDF_TARGET_ESP32C3
		help
			GPIO number (IOxx) to SPI DC.
			Some GPIOs are used for other purposes (flash connections, etc.) and cannot be used to DC.
			On the ESP32, GPIOs 35-39 are input-only so cannot be used as outputs.
			On the ESP32-S2, GPIO 46 is input-only so cannot be used as outputs.

	config RESET_GPIO
		int "RESET GPIO number"
		range 0 GPIO_RANGE_MAX
		default 33 if IDF_TARGET_ESP32
		default 38 if IDF_TARGET_ESP32S2
		default 41 if IDF_TARGET_ESP32S3
		default 3  if IDF_TARGET_ESP32C3
		help
			GPIO number (IOxx) to RESET.
			Some GPIOs are used for other purposes (flash connections, etc.) and cannot be used to RESET.
			On the ESP32, GPIOs 35-39 are input-only so cannot be used as outputs.
			On the ESP32-S2, GPIO 46 is input-only so cannot be used as outputs.

	config BL_GPIO
		int "BACKLIGHT GPIO number"
		range -1 GPIO_RANGE_MAX
		default 32 if IDF_TARGET_ESP32
		default 33 if IDF_TARGET_ESP32S2
		default 33 if IDF_TARGET_ESP32S3
		default 4  if IDF_TARGET_ESP32C3
		help
			GPIO number (IOxx) to BACKLIGHT.
			When it is -1, BACKLIGHT isn't performed.
			Some GPIOs are used for other purposes (flash connections, etc.) and cannot be used to BACKLIGHT.
			On the ESP32, GPIOs 35-39 are input-only so cannot be used as outputs.
			On the ESP32-S2, GPIO 46 is input-only so cannot be used as outputs.

	choice INVERSION
		prompt "Enable Display Inversion"
		default INVERSION_FALSE
		help
			Enable Display Inversion.
		config INVERSION_TRUE
			bool "TRUE"
			help
				Inverse Colors
		config INVERSION_FALSE
			bool "FALSE"
			help
				Dont't Inverse Colors
	endchoice

	choice SPI_HOST
		prompt "SPI peripheral that controls this bus"
		default SPI2_HOST
		help
			Select SPI peripheral that controls this bus.
		config SPI2_HOST
			bool "SPI2_HOST"
			help
				Use SPI2_HOST. This is also called HSPI_HOST.
		config SPI3_HOST
			bool "SPI3_HOST"
			help
				USE SPI3_HOST. This is also called VSPI_HOST
	endchoice

endmenu

menu "Joystick Configuration"

	config X_AXIS
		int "X-Axis ADC channel"
		range 0 7
		default 7 if IDF_TARGET_ESP32
		default 0 if IDF_TARGET_ESP32S2
		default 0 if IDF_TARGET_ESP32S3
		default 0 if IDF_TARGET_ESP32C3
		help
			Joystick ADC channel for the X Axis

	config Y_AXIS
		int "Y-Axis ADC channel"
		range 0 7
		default 6 if IDF_TARGET_ESP32
		default 1 if IDF_TARGET_ESP32S2
		default 1 if IDF_TARGET_ESP32S3
		default 1 if IDF_TARGET_ESP32C3
		help
			Joystick ADC channel for the Y Axis

	choice REVERSE_X_AXIS
		prompt "Reverse X-Axis"
		default REVERSE_X_AXIS_FALSE
		help
			Reverse X-Axis.
		config REVERSE_X_AXIS_TRUE
			bool "TRUE"
			help
				Flip the X-Axis
		config REVERSE_X_AXIS_FALSE
			bool "FALSE"
			help
				Don't Flip the X-Axis
	endchoice

	choice REVERSE_Y_AXIS
		prompt "Reverse Y-Axis"
		default REVERSE_Y_AXIS_FALSE
		help
			Reverse Y-Axis.
		config REVERSE_Y_AXIS_TRUE
			bool "TRUE"
			help
				Flip the Y-Axis
		config REVERSE_Y_AXIS_FALSE
			bool "FALSE"
			help
				Don't Flip the Y-Axis
	endchoice

endmenu
```
